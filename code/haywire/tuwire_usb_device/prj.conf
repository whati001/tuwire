## CMakeLists.txt
```
# SPDX-License-Identifier: Apache-2.0

cmake_minimum_required(VERSION 3.20.0)
find_package(Zephyr REQUIRED HINTS $ENV{ZEPHYR_BASE})
project(mass)


FILE(GLOB app_sources src/*.c)
target_sources(app PRIVATE ${app_sources})
```

## Kconfig
```
# Copyright (c) 2019-2020 Nordic Semiconductor ASA
# SPDX-License-Identifier: Apache-2.0

config USB_NERO_STACK_SIZE
	int "Define the Stack size for of the Nero driver thread"
	default 2048

config USB_NERO_BATCH_SIZE
	int "Define the batch size in bytes after which the Nero module will block the USB stack"
	default 1024
	help
		This value should be a multiple of the USB MPS value, and we recommend to use
		1024 in combination with the LittleFS and 4096 for FatFS dumping.


config USB_NERO_DUMP_H264
	bool "Option to enable storing the requested H.264 frame to disk"
	default y
	help
		If enable, the Nero USB driver will store all the received
		H.264 frames to the specified storage device.

config USB_NERO_DUMP_SIZE
	int "Define how many MB of video frames should be dump before the driver stops"
	default 10
	depends on USB_NERO_DUMP_H264
	help
		Define in MB how large the file on the LittleFS files system should be.
		This value is not allowed to exceed the overall partition size.

choice
	prompt "Storage and file system type used by Nero module"
	default USB_NERO_STORAGE_FLASH
	depends on USB_NERO_DUMP_H264

config USB_NERO_STORAGE_FLASH
	bool "Use flash memory to store frames and USB MSC to retrieve"

config USB_NERO_STORAGE_SDCARD
	bool "Use SDCARD to store frames"

endchoice

source "Kconfig.zephyr"
```

## prj.conf
```kconfig
CONFIG_LOG=y
CONFIG_STDOUT_CONSOLE=y
CONFIG_LOG_BUFFER_SIZE=16384

# USB device specific configuration
CONFIG_USB_DEVICE_VID=0x05ac
CONFIG_USB_DEVICE_PID=0x12ad
CONFIG_USB_DEVICE_PRODUCT="iAccy1"
CONFIG_USB_DEVICE_MANUFACTURER="Apple Inc."
CONFIG_USB_DEVICE_SN="nomac?123456"
CONFIG_USB_MAX_POWER=250
CONFIG_USB_DEVICE_REMOTE_WAKEUP=n

# enable USB stack
CONFIG_USB_DEVICE_STACK=y
CONFIG_USB_DEVICE_LOG_LEVEL_ERR=y
CONFIG_USB_DRIVER_LOG_LEVEL_INF=y
CONFIG_USB_DEVICE_INITIALIZE_AT_BOOT=n

# increase main thread stack
CONFIG_MAIN_STACK_SIZE=2048

# Nero module configuraiton
CONFIG_USB_NERO_DUMP_H264=n
```

## overlay-sdcard_storage.conf
```kconfig
# Nero module configuraiton
CONFIG_USB_NERO_DUMP_H264=y
CONFIG_USB_NERO_STORAGE_SDCARD=y
CONFIG_USB_NERO_DUMP_SIZE=20
CONFIG_USB_NERO_BATCH_SIZE=4096

# activate SPI
CONFIG_SPI=y

# activate SDMMC driver
CONFIG_DISK_DRIVER_SDMMC=y
CONFIG_FILE_SYSTEM=y

# FAT configuration
CONFIG_DISK_ACCESS=y
CONFIG_FAT_FILESYSTEM_ELM=y
CONFIG_FS_LOG_LEVEL_DBG=y
```

## src/main.c
```c
/*
 * Copyright (c) 2016 Intel Corporation.
 * Copyright (c) 2019-2020 Nordic Semiconductor ASA
 *
 * SPDX-License-Identifier: Apache-2.0
 */

#include <zephyr/kernel.h>
#include <zephyr/logging/log.h>
#include <zephyr/usb/usb_device.h>

LOG_MODULE_REGISTER(main);

// overwrite the weak serial number computation function
// we desire the value in CONFIG_USB_DEVICE_SN as serial number
uint8_t *usb_update_sn_string_descriptor(void)
{
	static uint8_t sn[sizeof(CONFIG_USB_DEVICE_SN) + 1];
	memset(sn, 0, sizeof(sn));
	memcpy(sn, CONFIG_USB_DEVICE_SN, sizeof(CONFIG_USB_DEVICE_SN));

	return sn;
}

void main(void)
{
	int ret;

	ret = usb_enable(NULL);
	if (ret != 0)
	{
		LOG_ERR("Failed to enable USB");
		return;
	}

	LOG_INF("The device is put in USB mass storage mode.\n");
}
```
